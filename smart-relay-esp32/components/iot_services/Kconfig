## smart-relay-esp32/components/iot_services/Kconfig
```kconfig
menu "IoT Service"
    choice
        prompt "Board type definition"
        default SMART_RELAY_WIFI_R1
    
        config SMART_RELAY_WIFI_R1
            tristate "Smart Relay WiFi R1"
            help 
                Select this option if you have a Smart Relay WiFi R1
        
        config DEVELOPMENT_BOARD
            tristate "Dev"
            help 
                Select this option if you have a development board (e.g. WROVER-KIT-V4)
        
    endchoice

    config IOT_BOARD_HREV
        int "Board hardware revision"
        default 1
        help 
            Board revision is used to select proper board pinout


    config IOT_IO_STORAGE_NAMESPACE
        string "Storage namespace used from IoT services"
        default "iot_services"
        help 
            Namespace is used to avoid collisions among different services that use storage



    config IOT_WIFI_SSID
        string "WiFi SSID"
        default "myssid"
        help
            SSID (network name) for the example to connect to.

    config IOT_WIFI_PASSWORD
        string "WiFi Password"
        default "mypassword"
        help
            WiFi password (WPA or WPA2) for the example to use.

    choice IOT_WIFI_SAE_MODE
        prompt "WPA3 SAE mode selection"
        default IOT_WIFI_WPA3_SAE_PWE_BOTH
        help
            Select mode for SAE as Hunt and Peck, H2E or both.
        config IOT_WIFI_WPA3_SAE_PWE_HUNT_AND_PECK
            bool "HUNT AND PECK"
        config IOT_WIFI_WPA3_SAE_PWE_HASH_TO_ELEMENT
            bool "H2E"
        config IOT_WIFI_WPA3_SAE_PWE_BOTH
            bool "BOTH"
    endchoice

    config IOT_WIFI_PW_ID
        string "PASSWORD IDENTIFIER"
        depends on  IOT_WIFI_WPA3_SAE_PWE_HASH_TO_ELEMENT|| IOT_WIFI_WPA3_SAE_PWE_BOTH
        default ""
        help
            password identifier for SAE H2E

    config IOT_WIFI_MAXIMUM_RETRY
        int "Maximum retry"
        default 5
        help
            Set the Maximum retry to avoid station reconnecting to the AP unlimited when the AP is really inexistent.

    choice IOT_WIFI_SCAN_AUTH_MODE_THRESHOLD
        prompt "WiFi Scan auth mode threshold"
        default IOT_WIFI_AUTH_WPA2_PSK
        help
            The weakest authmode to accept in the scan mode.
            This value defaults to IOT_WIFI_AUTH_WPA2_PSK incase password is present and IOT_WIFI_AUTH_OPEN is used.
            Please select IOT_WIFI_AUTH_WEP/IOT_WIFI_AUTH_WPA_PSK incase AP is operating in WEP/WPA mode.

        config IOT_WIFI_AUTH_OPEN
            bool "OPEN"
        config IOT_WIFI_AUTH_WEP
            bool "WEP"
        config IOT_WIFI_AUTH_WPA_PSK
            bool "WPA PSK"
        config IOT_WIFI_AUTH_WPA2_PSK
            bool "WPA2 PSK"
        config IOT_WIFI_AUTH_WPA_WPA2_PSK
            bool "WPA/WPA2 PSK"
        config IOT_WIFI_AUTH_WPA3_PSK
            bool "WPA3 PSK"
        config IOT_WIFI_AUTH_WPA2_WPA3_PSK
            bool "WPA2/WPA3 PSK"
        config IOT_WIFI_AUTH_WAPI_PSK
            bool "WAPI PSK"
    endchoice
            
endmenu
```

## smart-relay-esp32/main/Kconfig
```kconfig
menu "Main Service"
    
    config EDGE_SOFT_REV
        int "Software Revision"
        default 1
        help 
            Software revision.
    
    config EDGE_SOFT_MINOR
        int "Software Minor"
        default 1
        help 
            Software minor.

    config MANUFACTURE_NAME
        string "Manufactured company"
        default "clab"
        help 
            This is the company that manufactured the ble and deployed. 
    
    config MODEL_NAME
        string "Model name of the device"
        default "clab-smart-relay"
        help
            This is the device model name and number corresponding to it.   
    
    config STARTUP_LED_TIME_ON_MILLIS
        int "Startup led on interval (ms)"
        default 3000
        help 
            Time the led is switched on on startup.

    config MAIN_LOOP_INTERVAL_MILLIS
        int "Main loop task interval (ms)"
        default 60000
        help 
            Main task interval is used to schedule at precise intervall the main loop logic.
            

    config MAIN_REFRESH_TIME_EVERY_LOOPS
        int "Amount of main loops after while update the internal rtc time using network."
        default 10
        help 
            The actual time in milliseconds depends from the main loop interval.

    config MAIN_DISABLE_BLE_AFTER_MILLIS
        int "Number of millisecond after BLE will disable if no device is connected"
        default 0
        help 
            Used to disabled BLE if no one is using it. Should be multiple of MAIN_LOOP_INTERVAL_MILLIS.

    config MAIN_MQTT_BROKER_LISTEN_ON
        string "Mqtt broker listening address"
        default "0.0.0.0"
        help 
            Used to set listening source addresses to accept.
            

    config MAIN_MQTT_BROKER_LISTEN_PORT
        int "Mqtt broker listening port"
        default 1883
        help 
            Used to set listening port.
    
    config MAIN_MQTT_BROKER_DIN_CONF_CHANNEL
        int "Mqtt broker start locally if digital input high"
        default 1
        help 
            Used to decide if MQTT broker is needed.

    config MAIN_MQTT_BROKER_DEFAULT_URI
        string "Mqtt broker default URI"
        help 
            If defined mqtt client connects to this URI.

    config MAIN_DISCOVERY_SERVICE_PORT
        int "Discovery service port"
        default 46789
        help 
            Used to decice which port should be used from the discovery service.


    config CONTROL_LOOP_INTERVAL_MILLIS
        int "Control loop task interval (ms)"
        default 1000
        help 
            Control task interval is used to schedule at precise intervall the control loop logic.

    config CONTROL_SEND_STATUS_MAX_EVERY_LOOPS
        int "Amount of control loops from last time after while telemetry can be sent due to output ports change."
        default 30
        help 
            The actual time in milliseconds depends from the control loop interval.
        

endmenu
```
